## sdkconfig.defaults
```kconfig
CONFIG_BLINK_LED_GPIO=y
CONFIG_BLINK_GPIO=8
CONFIG_FORMAT_MJPEG_CAM1=y
CONFIG_UVC_MODE_ISOC_CAM1=y
CONFIG_FRAMESIZE_QVGA=y
CONFIG_UVC_CAM1_FRAMERATE=30
CONFIG_UVC_CAM1_FRAMESIZE_WIDTH=320
CONFIG_UVC_CAM1_FRAMESIZE_HEIGT=240
CONFIG_UVC_CAM1_MULTI_FRAMESIZE=n
```
